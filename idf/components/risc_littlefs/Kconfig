## idf/components/risc_littlefs/sdkconfig.defaults
```kconfig
# Exact shipped storage profile. Product activation is selected separately.
CONFIG_VFS_SUPPORT_DIR=y
CONFIG_LITTLEFS_MAX_PARTITIONS=3
CONFIG_LITTLEFS_PAGE_SIZE=256
CONFIG_LITTLEFS_OBJ_NAME_LEN=64
CONFIG_LITTLEFS_READ_SIZE=128
CONFIG_LITTLEFS_WRITE_SIZE=128
CONFIG_LITTLEFS_CACHE_SIZE=512
CONFIG_LITTLEFS_LOOKAHEAD_SIZE=128
CONFIG_LITTLEFS_BLOCK_CYCLES=512
CONFIG_LITTLEFS_USE_MTIME=y
CONFIG_LITTLEFS_MTIME_USE_SECONDS=y
CONFIG_LITTLEFS_MALLOC_STRATEGY_DEFAULT=y
CONFIG_LITTLEFS_ASSERTS=y
# CONFIG_LITTLEFS_SDMMC_SUPPORT is not set
# CONFIG_LITTLEFS_USE_ONLY_HASH is not set
# CONFIG_LITTLEFS_HUMAN_READABLE is not set
# CONFIG_LITTLEFS_MULTIVERSION is not set
# CONFIG_LITTLEFS_SPIFFS_COMPAT is not set
# CONFIG_LITTLEFS_OPEN_DIR is not set
# CONFIG_LITTLEFS_FLUSH_FILE_EVERY_WRITE is not set
# CONFIG_LITTLEFS_FCNTL_GET_PATH is not set
```

## idf/sdkconfig.defaults
```kconfig
CONFIG_IDF_TARGET="esp32s3"
CONFIG_ESPTOOLPY_FLASHSIZE_16MB=y
CONFIG_ESPTOOLPY_FLASHMODE_QIO=y
CONFIG_ESPTOOLPY_FLASHFREQ_80M=y
CONFIG_SPIRAM=y
CONFIG_SPIRAM_MODE_OCT=y
CONFIG_SPIRAM_SPEED_80M=y
CONFIG_SPIRAM_USE_MALLOC=y
CONFIG_SPIRAM_ALLOW_BSS_SEG_EXTERNAL_MEMORY=y
CONFIG_FREERTOS_HZ=1000
# Native application/provider calls share the main task. Keep the admitted
# infrastructure policy floor (4 KiB) after HTTPS and signed relay call depth.
CONFIG_ESP_MAIN_TASK_STACK_SIZE=24576
CONFIG_ESP_MAIN_TASK_AFFINITY_CPU1=y
CONFIG_ESP_CONSOLE_NONE=y
CONFIG_PARTITION_TABLE_CUSTOM=y
CONFIG_PARTITION_TABLE_CUSTOM_FILENAME="../partitions.csv"
CONFIG_ELF_LOADER=y
CONFIG_ELF_DYNAMIC_LOAD_SHARED_OBJECT=y
CONFIG_ELF_LOADER_LOAD_PSRAM=y
CONFIG_ELF_LOADER_LIBC_SYMBOLS=y
CONFIG_ELF_FILE_SYSTEM_BASE_PATH="/bootfs"
CONFIG_LIBC_NEWLIB=y
CONFIG_COMPILER_CXX_EXCEPTIONS=n
CONFIG_COMPILER_CXX_RTTI=n
CONFIG_BT_ENABLED=y
CONFIG_BT_CONTROLLER_ENABLED=y
CONFIG_BT_CONTROLLER_ONLY=y

CONFIG_ELF_LOADER_ESPIDF_SYMBOLS=n
CONFIG_ESP_PANIC_HANDLER_IRAM=y

CONFIG_ESP_CONSOLE_SECONDARY_NONE=y
CONFIG_MBEDTLS_EXTERNAL_MEM_ALLOC=y
CONFIG_MBEDTLS_CERTIFICATE_BUNDLE_CROSS_SIGNED_VERIFY=y

CONFIG_COMPILER_OPTIMIZATION_SIZE=y
CONFIG_ESP_DEFAULT_CPU_FREQ_MHZ_240=y
CONFIG_BOOTLOADER_APP_ROLLBACK_ENABLE=y
```
